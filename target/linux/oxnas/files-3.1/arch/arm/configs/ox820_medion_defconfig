## target/linux/oxnas/files-3.1/drivers/net/gmac/Kconfig
```kconfig
menuconfig SYNOPSYS_GMAC
	tristate "Synopsys Gigabit MAC"
	select CRC32
	select MII
	depends on ARCH_OX820 || ARCH_OXNAS
	help
		Driver for the Synopsys Gigabit MAC

if SYNOPSYS_GMAC

config OXNAS_LEON_X2
	bool "x2 Leon clock"
	depends on SYNOPSYS_GMAC
	default y

config OXNAS_IPV6_OFFLOAD
	bool "IPv6 offload"
	depends on SYNOPSYS_GMAC
	default y

config OXNAS_MAX_GMAC_UNITS
	int "How many Ethernet ports"
	depends on SYNOPSYS_GMAC
	default 1 if OXNAS_VERSION_OX810
	default 1 if OXNAS_VERSION_OX815
	default 1 if OXNAS_VERSION_OX820
	default 2 if OXNAS_VERSION_OX825

config OXNAS_NAPI_POLL_WEIGHT
	int "NAPI poll weight for GMAC driver"
	depends on SYNOPSYS_GMAC
	default 64
	help
			Allow the GMAC driver poll weight to be set

config OXNAS_GMAC_DDR_DESCRIPTORS
	bool "GMAC DDR Descriptors"
	depends on SYNOPSYS_GMAC
	default y

config OXNAS_GMAC_SRAM_TX_DESCRIPTORS
	bool "GMAC SRAM for Tx descriptors"
	depends on OXNAS_GMAC_DDR_DESCRIPTORS
	default n
	help
		If set then the Rx descriptors managed by the ARM will be in DDR
		while Tx descriptors managed by the Leon will be in SRAM

config OXNAS_COPRO_JOB_QUEUE_NUM_ENTRIES
	int "Number of entries in ARM/Leon Tx offload job queue"
	default 16 if OXNAS_GMAC_DDR_DESCRIPTORS
	default 8
endif
```

## target/linux/oxnas/files-3.3/arch/arm/mach-ox820/Kconfig
```kconfig
if ARCH_OX820

menu "Oxford Semiconductor NAS Options"

choice
	prompt "OXNAS system type"
	default OXNAS_VERSION_OX820

config OXNAS_VERSION_OX820
	bool "OX820"
	select USB_ARCH_HAS_EHCI
	select ARCH_WANT_OPTIONAL_GPIOLIB
	help
	  Support for the OX820 SoC

endchoice

menu "OX820 Implementations"

config MACH_POGOPLUGV3
	bool "Pogoplug V3"
	default y
	help
	 Support for the Cloud Engines Pogoplug V3 (Classic)

config MACH_POGOPLUGV3PCI
        bool "Pogoplug V3 PCI"
        default y
        help
         Support for the Cloud Engines Pogoplug V3 with PCI (Pro, Video)

config MACH_MLP89626
	bool "Medion Live P89626"
	default y
	help
	 Support for the Medion Life P89626

config MACH_IOMEGAHMNDCE
	bool "iomega Home Media Network Hard Drive Cloud Edition"
	default y
	help
	 Support for the iomega Home Media Network Hard Drive Cloud Edition

endmenu

config NOMINAL_RPSCLK_FREQ
        int "The input clock frequency to the RPS"
        default 6250000 
        help
	 The RPS clock feeds into a prescaler and from there feeds the RPS timers

config DESCRIPTORS_PAGES
        int "The number of SRAM memory pages to reserve for DMA descriptors"
        default 1
        help
	 Determines the number of pages of SRAM that are reserved for DMA descriptors

config SRAM_NUM_PAGES
        int "The number of SRAM memory pages present in the system"
        default 8
        help
	 Determines the number of pages of SRAM that are assumed to exist in the system memory map

config ODRB_NUM_SATA_PRD_ARRAYS
        int "ODRB_NUM_SATA_PRD_ARRAYS"
        default 2
        help
	 sata somthings...

config ARCH_OXNAS_MAX_SATA_SG_ENTRIES
        int "ARCH_OXNAS_MAX_SATA_SG_ENTRIES"
        default 64
        help
	 sata somthings... #2

config ODRB_SATA_PRD_ARRAY_SIZE
	int "ODRB_SATA_PRD_ARRAY_SIZE"
	default 256
	help
	 sata somthing... #3

config ARCH_OXNAS_UART1
	bool "Support UART1"
	default n
	help
	 This enables UART1 to be accessible to Linux.
	 UARTs will be mapped to ttySn numbers from UART1 to UART4, only
	 including those UARTs selected to be present
config ARCH_OXNAS_CONSOLE_UART
	int "The UART displaying console boot messages"
	default 1 if ARCH_OX820
	help
	 We should not reset the UART that is already in use as the 
	 console during boot

endmenu
endif
```
